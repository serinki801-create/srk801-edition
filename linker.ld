/* ============================================================================
 * linker.ld — Linker script for x86_64 AI-OS kernel
 * ============================================================================
 *
 * Определяет расположение секций в памяти (физических адресах).
 * GRUB загружает ядро по адресу 0x0010_0000 (1 МБ) по умолчанию.
 *
 * Секции:
 *   .multiboot — Multiboot2 header (должен быть в первых 8 КБ файла).
 *   .text      — исполняемый код (boot.asm, isr.asm, ...).
 *   .rodata    — константы (строки, таблицы).
 *   .data      — инициализированные данные.
 *   .bss       — неинициализированные данные (обнуляются при загрузке).
 * ============================================================================ */

ENTRY(start)

SECTIONS
{
    /* Начинаем с 1 МБ (0x0010_0000) — стандартное расположение ядра для GRUB. */
    . = 1M;

    /* Multiboot2 header (всегда в начале файла). */
    .multiboot ALIGN(8) : {
        *(.multiboot)
    }

    /* Исполняемый код (границы нужны NX-защите: только .text без NX). */
    .text ALIGN(0x1000) : {
        text_start = .;
        *(.text*)
        text_end = .;
    }

    /* Константы и строки. */
    .rodata ALIGN(0x1000) : {
        *(.rodata*)
    }

    /* Инициализированные данные. */
    .data ALIGN(0x1000) : {
        *(.data*)
    }

    /* Неинициализированные данные (BSS). */
    .bss ALIGN(0x1000) : {
        *(COMMON)
        *(.bss*)
    }

    /* Стек (16 КБ, выровнен по 16 байт). */
    .stack ALIGN(16) : {
        stack_bottom = .;
        . = . + 16K;
        stack_top = .;
    }

    /* Конец ядра (для PMM: всё ниже kernel_end занято). */
    kernel_end = .;
}
