/* ============================================================================
 * user.ld — Linker script тестовой userland-программы (ET_EXEC, 0x400000)
 * ============================================================================
 * База 0x400000 выбрана внутри первых 512 МБ (текущий identity paging ядра)
 * и заведомо выше ядра (ядро ~1-5 МБ). ELF-загрузчик ядра (elf.c) проверяет,
 * что PT_LOAD-сегменты лежат в [0x400000, 512MB) и не задевают ядро.
 * ============================================================================ */

ENTRY(_start)

SECTIONS
{
    . = 0x400000;

    .text ALIGN(0x1000) : {
        *(.text*)
    }

    .rodata ALIGN(0x1000) : {
        *(.rodata*)
    }

    .data ALIGN(0x1000) : {
        *(.data*)
    }

    .bss ALIGN(0x1000) : {
        *(COMMON)
        *(.bss*)
    }

    /DISCARD/ : {
        *(.note*)
        *(.note.*)
        *(.comment*)
        *(.eh_frame*)
    }
}
